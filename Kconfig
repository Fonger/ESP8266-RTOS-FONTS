## Kconfig
```kconfig
menu "fonts"

config FONTS_GLCD_5X7
    bool "FONTS_GLCD_5X7"
    default y
    help
        "hello how are you"

config FONTS_ROBOTO_8PT
    bool "FONTS_ROBOTO_8PT"
    default n
    help
        "hello how are you"

config FONTS_ROBOTO_10PT
    bool "FONTS_ROBOTO_10PT"
    default n
    help
        "hello how are you"

config FONTS_BITOCRA_4X7
    bool "FONTS_BITOCRA_4X7"
    default n
    help
        "hello how are you"

config FONTS_BITOCRA_6X11
    bool "FONTS_BITOCRA_6X11"
    default n
    help
        "hello how are you"

config FONTS_BITOCRA_7X13
    bool "FONTS_BITOCRA_7X13"
    default n
    help
        "hello how are you"

config FONTS_TERMINUS_6X12_ISO8859_1
    bool "FONTS_TERMINUS_6X12_ISO8859_1"
    default n
    help
        "hello how are you"

config FONTS_TERMINUS_8X14_ISO8859_1
    bool "FONTS_TERMINUS_8X14_ISO8859_1"
    default n
    help
        "hello how are you"

config FONTS_TERMINUS_BOLD_8X14_ISO8859_1
    bool "FONTS_TERMINUS_BOLD_8X14_ISO8859_1"
    default n
    help
        "hello how are you"

config FONTS_TERMINUS_10X18_ISO8859_1
    bool "FONTS_TERMINUS_10X18_ISO8859_1"
    default n
    help
        "hello how are you"

config FONTS_TERMINUS_BOLD_10X18_ISO8859_1
    bool "FONTS_TERMINUS_BOLD_10X18_ISO8859_1"
    default n
    help
        "hello how are you"

config FONTS_TERMINUS_11X22_ISO8859_1
    bool "FONTS_TERMINUS_11X22_ISO8859_1"
    default n
    help
        "hello how are you"

config FONTS_TERMINUS_BOLD_11X22_ISO8859_1
    bool "FONTS_TERMINUS_BOLD_11X22_ISO8859_1"
    default n
    help
        "hello how are you"

config FONTS_TERMINUS_12X24_ISO8859_1
    bool "FONTS_TERMINUS_12X24_ISO8859_1"
    default n
    help
        "hello how are you"

config FONTS_TERMINUS_BOLD_12X24_ISO8859_1
    bool "FONTS_TERMINUS_BOLD_12X24_ISO8859_1"
    default n
    help
        "hello how are you"

config FONTS_TERMINUS_14X28_ISO8859_1
    bool "FONTS_TERMINUS_14X28_ISO8859_1"
    default n
    help
        "hello how are you"

config FONTS_TERMINUS_BOLD_14X28_ISO8859_1
    bool "FONTS_TERMINUS_BOLD_14X28_ISO8859_1"
    default n
    help
        "hello how are you"

config FONTS_TERMINUS_16X32_ISO8859_1
    bool "FONTS_TERMINUS_16X32_ISO8859_1"
    default n
    help
        "hello how are you"

config FONTS_TERMINUS_BOLD_16X32_ISO8859_1
    bool "FONTS_TERMINUS_BOLD_16X32_ISO8859_1"
    default n
    help
        "hello how are you"

config FONTS_TERMINUS_6X12_KOI8_R
    bool "FONTS_TERMINUS_6X12_KOI8_R"
    default n
    help
        "hello how are you"

config FONTS_TERMINUS_8X14_KOI8_R
    bool "FONTS_TERMINUS_8X14_KOI8_R"
    default n
    help
        "hello how are you"

config FONTS_TERMINUS_BOLD_8X14_KOI8_R
    bool "FONTS_TERMINUS_BOLD_8X14_KOI8_R"
    default n
    help
        "hello how are you"

config FONTS_TERMINUS_14X28_KOI8_R
    bool "FONTS_TERMINUS_14X28_KOI8_R"
    default n
    help
        "hello how are you"

config FONTS_TERMINUS_BOLD_14X28_KOI8_R
    bool "FONTS_TERMINUS_BOLD_14X28_KOI8_R"
    default n
    help
        "hello how are you"

config FONTS_TERMINUS_16X32_KOI8_R
    bool "FONTS_TERMINUS_16X32_KOI8_R"
    default n
    help
        "hello how are you"

config FONTS_TERMINUS_BOLD_16X32_KOI8_R
    bool "FONTS_TERMINUS_BOLD_16X32_KOI8_R"
    default n
    help
        "hello how are you"

endmenu
```
